## exianb-dev/Kconfig
```kconfig
config PVM_MOD
    bool "Linux Kernel Module for Safe Memory Access"
    default y
    help
      Built-in driver for Safe Memory Access.
      This will always be compiled into the kernel image (vmlinux/Image).
      No .ko file will be produced.
```

## hello-world/Kconfig
```kconfig
config PVM_MOD
	tristate "Safe Memory Access (PVM)"
	# no: depends on MODULES
	default y
	help
	  Built-in or module. Set to Y in defconfig fragment to include in the image.
```

## offset_printer/Kconfig
```kconfig
menu "Custom Kernel Modules"
config OFFSET_PRINTER
	tristate "Offset Printer Kernel Module"
	depends on MODULES
	default m
	help
	  Prints struct input_dev member offsets to dmesg at module load.
endmenu
```
